# BLANK register map
Vendor: BLANK; Series: BLANK Series; File version: 1.0
BLANK Description
CPU: CM0+ r2p1, little endian, no MPU, no FPU, 3 interrupt priority bits
Registers are 32-bit, access not given, no defined reset value unless marked. A register's access mark holds for its fields unless they carry their own. Offsets are from the block's base; lines under a group give offsets from that group; [hi:lo] are bit positions; {n}, {i} and the like mark numbered series; 'fields as' and 'values as' point back to an identical list; <NAME> marks a mode.

## Memory map
? ?

## ?
Base ?
? ?
  [?] ?

## Licence text in the file
---------------------------------------------------------------------------- No idea, anyone go at it, use at your own risk ----------------------------------------------------------------------------
